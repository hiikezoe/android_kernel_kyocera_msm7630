## drivers/sdcarddriver/Kconfig
```kconfig
config SD_CARD_GPIO_CONTROL
	tristate "GPIO Wrapper of SD Card Control Driver"
	default y
```

## security/kyocera/Kconfig
```kconfig
config SECURITY_KCLSM
	bool "KCLSM LSM Support"
	depends on SECURITY
	default n
	help
	  This is a KCLSM LSM module.

	  If you are unsure how to answer this question, answer N.

config SECURITY_KCLSM_PTRACE
	bool "KCLSM LSM ptrace_access_check Support"
	depends on SECURITY_KCLSM
	default n
	help
	  This is a KCLSM LSM ptrace_access_check module Support.

	  If you are unsure how to answer this question, answer N.

config SECURITY_KCLSM_INSMOD
	bool "KCLSM LSM kernel_setup_load_info Support"
	depends on SECURITY_KCLSM
	default n
	help
	  This is a KCLSM LSM kernel_setup_load_info module Support.

	  If you are unsure how to answer this question, answer N.

config SECURITY_KCLSM_MOUNT
	bool "KCLSM LSM sb_mount device permission Support"
	depends on SECURITY_KCLSM
	default n
	help
	  This is a KCLSM LSM device permission with sb_mount module Support.

	  If you are unsure how to answer this question, answer N.

config SECURITY_KCLSM_UMOUNT
	bool "KCLSM LSM sb_umount Support"
	depends on SECURITY_KCLSM
	default n
	help
	  This is a KCLSM LSM sb_umount module Support.

	  If you are unsure how to answer this question, answer N.

config SECURITY_KCLSM_PIVOTROOT
	bool "KCLSM LSM sb_pivotroot Support"
	depends on SECURITY_KCLSM
	default n
	help
	  This is a KCLSM LSM sb_pivotroot module Support.

	  If you are unsure how to answer this question, answer N.

config SECURITY_KCLSM_CHROOT
	bool "KCLSM LSM path_chroot Support"
	depends on SECURITY_KCLSM && SECURITY_PATH
	default n
	help
	  This is a KCLSM LSM path_chroot module Support.

	  If you are unsure how to answer this question, answer N.

config SECURITY_KCLSM_DEVICEPERMISSION
	bool "KCLSM LSM path_mknod path_chmod path_chown Support"
	depends on SECURITY_KCLSM && SECURITY_PATH
	default n
	help
	  This is a KCLSM LSM path_mknod path_chmod path_chown module Support.

	  If you are unsure how to answer this question, answer N.
```
